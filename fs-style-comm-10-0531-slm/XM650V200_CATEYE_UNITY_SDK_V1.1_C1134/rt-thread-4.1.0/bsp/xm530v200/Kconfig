## fs-style-comm-10-0531-slm/XM650V200_CATEYE_UNITY_SDK_V1.1_C1134/rt-thread-4.1.0/bsp/xm530v200/Kconfig
```kconfig
mainmenu "RT-Thread Project Configuration"

config BSP_DIR
    string
    option env="BSP_ROOT"
    default "."

config RTT_DIR
    string
    option env="RTT_ROOT"
    default "../.."

config PKGS_DIR
    string
    option env="PKGS_ROOT"
    default "packages"

config BOARD_XM530V200
    bool 
    default y
config RT_USING_CACHE
    bool 
    default y
config RT_USING_L2CACHE
    bool 
    default y

source "$RTT_DIR/Kconfig"
source "$PKGS_DIR/Kconfig"

config RT_USING_FPU
	bool "Using Float Point Unit"
	default y
	help
	Using Float Point Unit in code.



config SOC_XM530V200
    bool
    select ARCH_ARM_CORTEX_A5
	select ARCH_ARM_CORTEX_FPU
    select RT_USING_GIC_V2
    select RT_USING_COMPONENTS_INIT
    select RT_USING_USER_MAIN
    default y

source "$BSP_DIR/drivers/Kconfig"
```
